/* Copyright (c) 2015-2016, The Linux Foundation. All rights reserved.
 *
 * This program is free software; you can redistribute it and/or modify
 * it under the terms of the GNU General Public License version 2 and
 * only version 2 as published by the Free Software Foundation.
 *
 * This program is distributed in the hope that it will be useful,
 * but WITHOUT ANY WARRANTY; without even the implied warranty of
 * MERCHANTABILITY or FITNESS FOR A PARTICULAR PURPOSE.  See the
 * GNU General Public License for more details.
 */

&mdss_mdp {
	dsi_auo_amoled_cmd: qcom,mdss_dsi_auo_amoled_cmd {
		qcom,mdss-dsi-panel-name = "AUO AMOLED command mode dsi panel";
		qcom,mdss-dsi-panel-controller = <0x93>;
		qcom,mdss-dsi-panel-type = "dsi_cmd_mode";
		qcom,mdss-dsi-panel-destination = "display_1";
		qcom,mdss-dsi-panel-framerate = <0x3c>;
		qcom,mdss-dsi-virtual-channel-id = <0x0>;
		qcom,mdss-dsi-stream = <0x0>;
		qcom,mdss-dsi-panel-width = <0x190>;
		qcom,mdss-dsi-panel-height = <0x190>;
		qcom,mdss-dsi-h-front-porch = <0x6>;
		qcom,mdss-dsi-h-back-porch = <0x6>;
		qcom,mdss-dsi-h-pulse-width = <0x6>;
		qcom,mdss-dsi-h-sync-skew = <0x0>;
		qcom,mdss-dsi-v-back-porch = <0x6>;
		qcom,mdss-dsi-v-front-porch = <0x6>;
		qcom,mdss-dsi-v-pulse-width = <0x2>;
		qcom,mdss-dsi-h-left-border = <0x0>;
		qcom,mdss-dsi-h-right-border = <0x0>;
		qcom,mdss-dsi-v-top-border = <0x0>;
		qcom,mdss-dsi-v-bottom-border = <0x0>;
		qcom,mdss-dsi-bpp = <0x18>;
		qcom,mdss-dsi-color-order = "rgb_swap_rgb";
		qcom,mdss-dsi-underflow-color = <0xff>;
		qcom,mdss-dsi-border-color = <0x0>;
		qcom,mdss-dsi-pixel-packing = "tight";
		qcom,mdss-dsi-pixel-alignment = <0x0>;
		qcom,mdss-dsi-on-command = [15 01 00 00 05 00 02 00 00 15 01 00 00 00 00 02 fe 05 15 01 00 00 00 00 02 05 00 15 01 00 00 00 00 02 fe 07 15 01 00 00 00 00 02 07 4f 15 01 00 00 00 00 02 fe 0a 15 01 00 00 00 00 02 1c 1b 15 01 00 00 00 00 02 fe 00 15 01 00 00 00 00 02 35 00 05 01 00 00 00 00 02 11 00 15 01 00 00 00 00 02 22 00 15 01 00 00 ff 00 02 00 00 15 01 00 00 2d 00 02 00 00];
		qcom,mdss-dsi-post-panel-on-command = [05 01 00 00 00 00 02 29 00 15 01 00 00 00 00 02 13 00];
		qcom,mdss-dsi-off-command = [05 01 00 00 32 00 02 28 00 05 01 00 00 78 00 02 10 00];
		qcom,mdss-dsi-on-command-state = "dsi_hs_mode";
		qcom,mdss-dsi-off-command-state = "dsi_hs_mode";
		qcom,mdss-dsi-h-sync-pulse = <0x1>;
		qcom,mdss-dsi-traffic-mode = "burst_mode";
		qcom,mdss-dsi-lane-map = "lane_map_0123";
		qcom,mdss-dsi-bllp-eof-power-mode;
		qcom,mdss-dsi-bllp-power-mode;
		qcom,mdss-dsi-lane-0-state;
		qcom,mdss-dsi-te-pin-select = <0x1>;
		qcom,mdss-dsi-te-v-sync-rd-ptr-irq-line = <0x2c>;
		qcom,mdss-dsi-te-dcs-command = <0x1>;
		qcom,mdss-dsi-te-check-enable;
		qcom,mdss-dsi-te-using-te-pin;
		qcom,mdss-dsi-panel-timings = <0x540e0a00 0x2e320e12 0xa030400>;
		qcom,mdss-dsi-t-clk-post = <0x5>;
		qcom,mdss-dsi-t-clk-pre = <0x13>;
		qcom,mdss-dsi-bl-min-level = <0x1>;
		qcom,mdss-dsi-bl-max-level = <0xff>;
		qcom,mdss-dsi-dma-trigger = "trigger_sw";
		qcom,mdss-dsi-mdp-trigger = "none";
		qcom,mdss-dsi-bl-pmic-control-type = "bl_ctrl_dcs";
		qcom,mdss-dsi-reset-sequence = <0x0 0xa 0x1 0xa>;
		qcom,panel-supply-entries = <0x92>;
	};
};
